## arch/arm/mach-s5p6442/Kconfig
```kconfig
# arch/arm/mach-s5p6442/Kconfig
#
# Copyright 2008 Openmoko, Inc.
# Copyright 2008 Simtec Electronics
#
# Licensed under GPLv2

# Configuration options for the S5P6442 CPU

config CPU_S5P6442
	bool
	select CPU_S5P6442_INIT
	select CPU_S5P6442_CLOCK
	help
	  Enable S5P6442 CPU support

config S5P6442_SETUP_SDHCI
	bool
	help
	  Internal helper functions for S5P6442 based SDHCI systems

config MACH_SMDK6442
	bool "SMDK6442"
	select CPU_S5P6442
	select S3C_DEV_HSMMC
	select S3C_DEV_HSMMC1 if !SMDK6442_SD_CH0_8BIT
	select S3C_DEV_HSMMC2
	select S3C_DEV_I2C1
	select S5P6442_SETUP_SDHCI
	select S5P64XX_SETUP_I2C1
	select S3C_DMA_PL330
	help
	  Machine support for the Samsung SMDK6442

        comment "MMC/SD slot setup"
        depends on MACH_SMDK6442

config SMDK6442_SD_CH0_8BIT
        bool "Use 8-bit bus with channel 0"
        depends on MACH_SMDK6442
        default n
        help
          If channel 0 uses 8-bit bus, channel 1 shoule be disabled.
```

## arch/arm/mach-s5pc110/Kconfig
```kconfig
# arch/arm/mach-s5pc110/Kconfig
#
# Copyright 2008 Openmoko, Inc.
# Copyright 2008 Simtec Electronics
#
# Licensed under GPLv2

# Configuration options for the S5PC110 CPU

config CPU_S5PC110
	bool
	select CPU_S5PC110_INIT
	select CPU_S5PC110_CLOCK
	help
		Enable S5PC110 CPU support

config S5PC11X_SETUP_SDHCI
	bool
	help
		Internal helper functions for S5PC1XX based SDHCI systems

config MACH_SMDKC110
	bool "SMDKC110"
	select CPU_S5PC110
	select S3C_DMA_PL330
	select S3C_DEV_I2C1
	select S3C_DEV_I2C2
	select S3C_DEV_HSMMC
	select S3C_DEV_HSMMC1 if !S5PC110_SD_CH0_8BIT
	select S3C_DEV_HSMMC2
	select S3C_DEV_HSMMC3 if !S5PC110_SD_CH2_8BIT       
	select S5PC11X_SETUP_SDHCI
	select S3C64XX_SETUP_I2C1
	select ARCH_DISCONTIGMEM_ENABLE
	select REGULATOR
	select REGULATOR_MAX8698
	help
	  Machine support for the Samsung SMDKC110

	comment "CPU type selection"
choice
	prompt "Setup CPU Type for S5PC110"
	depends on PLAT_S5PC11X
	default S5PC110_B_TYPE

config S5PC110_H_TYPE
	bool "Select H-Type"
	depends on PLAT_S5PC11X && VMSPLIT_3G
	help
		Select H-Type of S5PC110

config S5PC110_AC_TYPE
	bool "select AC-Type"
	depends on PLAT_S5PC11X && VMSPLIT_3G
	help
		Select AC-Type of S5PC110

config S5PC110_B_TYPE
	bool "select B-Type"
	depends on PLAT_S5PC11X && VMSPLIT_2G
	help
		Select B-Type of S5PC110

config S5PC110_D_TYPE
	bool "select D-Type"
	depends on PLAT_S5PC11X && VMSPLIT_2G
	help
		Select D-Type of S5PC110
endchoice

choice
	prompt "CPU revision"
	depends on CPU_S5PC110 && !S5P_DEEP_IDLE_TEST
	default	CPU_S5PC110_EVT1
	 
config CPU_S5PC110_EVT0_ERRATA
	bool "EVT0"
	help
	  Fixup known bug on s5pc110 evt0 version.

config CPU_S5PC110_EVT1
	bool "EVT1"
	help
	  Support EVT1(S5PC110)

endchoice

	comment "MMC/SD slot setup"
	depends on PLAT_S5PC11X	

config S5PC110_SD_CH0_8BIT
	bool "Use 8-bit bus with channel 0"
	depends on PLAT_S5PC11X
	default n
	help
		IF channel 0 uses 8-bit bus, channel 1 shoule be disabled.
       
config S5PC110_SD_CH2_8BIT
	bool "Use 8-bit bus with channel 2"
	depends on PLAT_S5PC11X
	default n	
	help
		IF channel 2 uses 8-bit bus, channel 3 shoule be disabled.

config DM9000_16BIT
	bool "Use 16-bit bus for DM9000 ethernet controller"
	depends on MACH_SMDKC110
	default n	
	help
		Some SMDKC110 board have 16bit data bus for DM9000 ethernet controller..
```

## arch/arm/plat-s5p64xx/Kconfig
```kconfig
# arch/arm/plat-s5p64xx/Kconfig
#
# Copyright 2008 Openmoko, Inc.
# Copyright 2008 Simtec Electronics
#	Ben Dooks <ben@simtec.co.uk>
#
# Licensed under GPLv2

config PLAT_S5P64XX
	bool
	depends on ARCH_S5P64XX
	select PLAT_S3C
	select ARM_VIC
	default y
	select NO_IOPORT
	select ARCH_REQUIRE_GPIOLIB
	select S3C_GPIO_TRACK
	select S3C_GPIO_PULL_UPDOWN
	select S3C_GPIO_CFG_S5P64XX
	help
	  Base platform code for any Samsung S5P64XX device

if PLAT_S5P64XX

# Configuration options shared by all S5P64XX implementations

config CPU_S5P6442_INIT
	bool
	help
	  Initialisation code for the S5P6440. 

config CPU_S5P6442_CLOCK
	bool
	help
	  Clock support code for the S5P6440.

# platform specific device setup

config S5P64XX_SETUP_I2C0
	bool
	default y
	help
	  Common setup code for i2c bus 0.

	  Note, currently since i2c0 is always compiled, this setup helper
	  is always compiled with it.

config S5P64XX_SETUP_I2C1
	bool
	help
	  Common setup code for i2c bus 1.

config S5P64XX_SETUP_I2C2
	bool
	help
	  Common setup code for i2c bus 2.

# FIMC part
config S5P64XX_DEV_FIMC0
	bool
	default y
	help
	  Compile in platform device definitions for FIMC controller 0

config S5P64XX_DEV_FIMC1
	bool
	default y
	help
	  Compile in platform device definitions for FIMC controller 1

config S5P64XX_DEV_FIMC2
	bool
	default y
	help
	  Compile in platform device definitions for FIMC controller 2

config S5P64XX_SETUP_FIMC0
	bool
	default y
	help
	  Common setup code for FIMC controller 0.

config S5P64XX_SETUP_FIMC1
	bool
	default y
	help
	  Common setup code for FIMC controller 1.

config S5P64XX_SETUP_FIMC2
	bool
	default y
	help
	  Common setup code for FIMC controller 2.
	  
# FB part
config S5P64XX_DEV_FB
	bool
	depends on FB_S3C
	default y
	help
	  Compile in platform device definitions for FIMD controller

config S5P64XX_SETUP_FB
	bool
	depends on FB_S3C
	default y
	help
	  Common setup code for FIMD controller.

config S5P64XX_ADC
        bool "S5P64XX ADC D/D support"
        help
         Analog to Digital conversion(ADC) D/D for S5P64XX support

config S5P64XX_PWM
	bool "S5P64XX PWM support"
	select HAVE_PWM
	help
	  Support for exporting the PWM timer blocks via the pwm device system.

config CONFIG_HIGH_RES_TIMERS
	bool "HRtimer and Dynamic Tick support"
	select GENERIC_TIME
	select GENERIC_CLOCKEVENTS
	default n
	help
	  Support for HRtimer and Dynamic Tick system.

endif
```

## drivers/media/video/samsung/cmm/Kconfig
```kconfig
#
# Configuration for CMM
#

config VIDEO_CMM
	bool "Samsung CMM Driver"
	depends on VIDEO_SAMSUNG && CPU_S5PC110
	default n
	---help---
	  This is a CMM driver for Samsung S5PC110.
```

## drivers/media/video/samsung/fimc/Kconfig
```kconfig
config VIDEO_FIMC
	bool "Samsung Camera Interface (FIMC) driver"
	depends on VIDEO_SAMSUNG && (CPU_S5PC100 || CPU_S5PC110 || CPU_S5P6442)
	default n
	---help---
	  This is a video4linux driver for Samsung FIMC device.

config VIDEO_FIMC_DEBUG
	bool "FIMC driver debug messages"
	depends on VIDEO_FIMC

config VIDEO_FIMC_MIPI
	bool "MIPI-CSI2 Slave Interface support"
	depends on VIDEO_FIMC && (CPU_S5PC100 || CPU_S5PC110)

config VIDEO_FIMC_DYNAMIC_BUFFER
	bool "Dynamic Buffer support (EXPERIMENTAL)"
	depends on VIDEO_FIMC && CPU_S5PC110
	---help---
	  This enables changing buffer address at run-time for large buffers.
	  User must configure the buffer count as 12 using VIDIOC_REQBUFS ioctl and
	  the mmap() is disabled for this feature, only available to take physical addresses
	  using VIDIOC_S_CTRL with V4L2_CID_PADDR_# arguments.

config VIDEO_IPC
	bool "IPC support"
	depends on VIDEO_FIMC && CPU_S5PC110
```

## drivers/media/video/samsung/fimc2/Kconfig
```kconfig
if VIDEO_FIMC2
comment "FIMC2 configurations"
endif

config VIDEO_FIMC2
	bool "Samsung Camera Interface (FIMC2) driver - temporary"
	depends on VIDEO_SAMSUNG && ARCH_S5PC1XX
	default n
	---help---
	  This is a video4linux driver for Samsung FIMC device.

config VIDEO_FIMC_DEBUG
	bool "FIMC driver debug messages"
	depends on VIDEO_FIMC2

config VIDEO_FIMC_MIPI
	bool "FIMC works with MIPI-CSI2 (Rx)"
	depends on VIDEO_FIMC2 && ARCH_S5PC1XX

config VIDEO_FIMC_CAM_CH
	int "External Camera channel (0=A, 1=B)"
	depends on VIDEO_FIMC2
	default "0"

config VIDEO_FIMC_CAM_RESET
	int "Reset Type (0=low, 1=high)"
	depends on VIDEO_FIMC2
	default "0"
```

## drivers/media/video/samsung/g2d/Kconfig
```kconfig
#
# Configuration for FIMG-2D
#
config VIDEO_G2D
		bool "Samsung FIMG-2D Driver"
		depends on VIDEO_SAMSUNG && (CPU_S5PC110)
		default n
		---help---
			This is a FIMG-2D(2D accelerator) driver for Samsung S5PC110.

config VIDEO_G2D_DEBUG
		bool "G2D Driver Debug Messages"
		depends on VIDEO_G2D
		default n
		---help---
			This enables G2D driver debug messages
```

## drivers/media/video/samsung/tv20/Kconfig
```kconfig
#
# Configuration for Post Porcessor
#

config VIDEO_TV20
	bool "Samsung TV Driver for s5pc1xx & s5pc11x" 
	depends on VIDEO_SAMSUNG
	default n
	---help---
	  This is a TV driver for Samsung SMDK_S5PC100 & SMDK_S5PC110

config HDMI_CEC
	bool "HDMI CEC driver support. (only s5pc110)" 
	depends on VIDEO_TV20 && CPU_S5PC110
	default n
	---help---
	  This is a HDMI CEC driver for Samsung SMDK_S5PC110
```

## sound/soc/s3c/Kconfig
```kconfig
config SND_S5P_SOC
	tristate "Samsung SoC LP-Audio Drivers"
	depends on !SND_S3C24XX_SOC && (ARCH_S5PC1XX || ARCH_S5PC11X)
	help
	  Say Y or M if you want to add support for codecs attached to
	  the S3C AC97, I2S or SSP interface. You will also need
	  to select the audio interfaces to support below.

config SND_S3C_I2S_V50
	tristate

choice
	prompt "Select the codec driver"
	depends on SND_S5P_SOC

config  SND_SMDKC110_WM8580
	tristate "WM8580-I2S on SMDKC110"
	depends on ARCH_S5PC11X
	select SND_S3C_I2S_V50
	select SND_SOC_WM8580

config  SND_SMDKC100_WM8580
	tristate "WM8580-I2S on SMDKC100"
	depends on ARCH_S5PC1XX
	select SND_S3C_I2S_V50
	select SND_SOC_WM8580

config  SND_SMDK6442_WM8580
	tristate "WM8580-I2S on SMDK6442"
	depends on ARCH_S5P64XX
	select SND_S3C_I2S_V50
	select SND_SOC_WM8580

endchoice

config  SND_WM8580_MASTER
	bool "WM8580 Codec is I2S Master"
	depends on SND_SMDKC110_WM8580 || SND_SMDKC100_WM8580 || SND_SMDK6442_WM8580
	default y
	help
	  Say Y if you want to run SoC as I2S-Slave and CODEC as I2S-Master.

config  S5P_USE_CLKAUDIO
	bool "Use CLKAUDIO"
	depends on !SND_WM8580_MASTER && (SND_SMDKC110_WM8580 || SND_SMDKC100_WM8580 || SND_SMDK6442_WM8580)
	default y
	help
	  Say Y if you want to generate I2S signals(LRCLK and BCLK) from CLKAUDIO.
	  Do not select it for SoC I2S-Slave mode.
	  If this is not selected in SoC I2S-Master mode, then PCLK will be used to
	  generate(LRCLK and BCLK) signals.
```

## sound/soc/s3c24xx/Kconfig
```kconfig
config SND_S3C24XX_SOC
	tristate "Samsung SoC Audio Drivers"
	depends on ARCH_S5PC1XX || ARCH_S5PC11X || ARCH_S5P64XX
	help
	  Say Y or M if you want to add support for codecs attached to
	  the Samsung AC97, I2S or SSP interface. You will also need
	  to select the audio interfaces to support below.

config SND_S3C24XX_SOC_I2S
	tristate

config SND_S3C_I2SV2_SOC
	tristate

config SND_S3C2412_SOC_I2S
	tristate

config SND_S5P_USE_XCLK_OUT
	bool
	depends on MACH_SMDKC110
	default y

config SND_S5P_SOC_I2S
	tristate
	select SND_S3C_I2SV2_SOC

config SND_S3C2443_SOC_AC97
	tristate
	select AC97_BUS
	select SND_SOC_AC97_BUS

config SND_S5P_SOC_AC97
	tristate
	select AC97_BUS
	select SND_SOC_AC97_BUS

config SND_S3C_SOC_PCM
	tristate

config SND_S5P_SOC_WM8580
	tristate "SoC Audio support for WM8580 on SMDK-S5P"
	depends on SND_S3C24XX_SOC && (MACH_SMDKC110 || MACH_SMDKC100)
	select SND_SOC_WM8580
	help
	  Sat Y if you want to add support for SoC audio on the SMDKS5P.

choice
	prompt "Select WM8580 Audio Primary Port Type"
	depends on SND_S5P_SOC_WM8580 && (MACH_SMDKC110 || MACH_SMDKC100)

config	SND_S5P_PRIMARY_NONE
	bool "None"

config	SND_S5P_PRIMARY_I2S
	bool "Use I2S-v5 Bus"
	select SND_S5P_SOC_I2S

endchoice

choice
	prompt "Select WM8580 Audio Secondary Port Type"
	depends on SND_S5P_SOC_WM8580 && (MACH_SMDKC110 || MACH_SMDKC100)

config	SND_S5P_SECONDARY_NONE
	bool "None"

config	SND_S5P_SECONDARY_I2S
	bool "Use I2S-v2 Bus"
	select SND_S5P_SOC_I2S
	select SND_S3C_I2SV2_SOC

config	SND_S5P_SECONDARY_PCM
	bool "Use PCM Bus"
	depends on SND_S5P_USE_XCLK_OUT
	select SND_S3C_SOC_PCM

endchoice


config SND_WM8580_MASTER
	bool "WM8580 Codec is I2S Master"
	depends on SND_S5P_SOC_WM8580 && (SND_S5P_PRIMARY_I2S || \
			SND_S5P_SECONDARY_I2S)
	default n
	help
	  Say Y if you want to run SoC as I2S-Slave and CODEC as I2S-Master.

config SND_S3C24XX_SOC_NEO1973_WM8753
	tristate "SoC I2S Audio support for NEO1973 - WM8753"
	depends on SND_S3C24XX_SOC && MACH_NEO1973_GTA01
	select SND_S3C24XX_SOC_I2S
	select SND_SOC_WM8753
	help
	  Say Y if you want to add support for SoC audio on smdk2440
	  with the WM8753.

config SND_S3C24XX_SOC_SMDK2443_WM9710
	tristate "SoC AC97 Audio support for SMDK2443 - WM9710"
	depends on SND_S3C24XX_SOC && MACH_SMDK2443
	select SND_S3C2443_SOC_AC97
	select SND_SOC_AC97_CODEC
	help
	  Say Y if you want to add support for SoC audio on smdk2443
	  with the WM9710.

config SND_S3C24XX_SOC_LN2440SBC_ALC650
	tristate "SoC AC97 Audio support for LN2440SBC - ALC650"
	depends on SND_S3C24XX_SOC
	select SND_S3C2443_SOC_AC97
	select SND_SOC_AC97_CODEC
	help
	  Say Y if you want to add support for SoC audio on ln2440sbc
	  with the ALC650.

config SND_S3C24XX_SOC_S3C24XX_UDA134X
	tristate "SoC I2S Audio support UDA134X wired to a S3C24XX"
       	depends on SND_S3C24XX_SOC
       	select SND_S3C24XX_SOC_I2S
       	select SND_SOC_UDA134X

config SND_S5P_SOC_SMDK_WM9713
	tristate "SoC AC97 Audio support for SMDKS5P - WM9713"
	depends on SND_S3C24XX_SOC && (MACH_SMDKC110 || MACH_SMDKC100)
	select SND_S5P_SOC_AC97
	select SND_SOC_AC97_CODEC
	select SND_SOC_WM9713
	help
	  Say Y if you want to add support for SoC audio on smdks5p
	  with the WM9713.

config SND_S5PC100_SOC_UNIVERSAL_AK4671
	tristate "SoC I2S Audio support for UNIVERSAL - AK4671"
	depends on MACH_UNIVERSAL
	select SND_S5P_SOC_I2S
	select SND_SOC_AK4671
	select SND_SOC_MAX9877
	help
	  Say Y if you want to add support for SoC audio on universal
	  with the AK4671.
```
